## system/buildroot/external/Config.in
```kconfig
menu "DaOS Camera / Project Walnut"

source "$BR2_EXTERNAL_DAOS_CAMERA_PATH/package/hasslefree/Config.in"

endmenu
```

## system/buildroot/external/configs/daos_camera_qemu_aarch64_defconfig
```kconfig
BR2_aarch64=y
BR2_cortex_a53=y
BR2_TOOLCHAIN_EXTERNAL=y
BR2_TOOLCHAIN_EXTERNAL_BOOTLIN=y
BR2_TOOLCHAIN_EXTERNAL_BOOTLIN_AARCH64_GLIBC_STABLE=y
BR2_JLEVEL=16
BR2_REPRODUCIBLE=y
BR2_TARGET_GENERIC_HOSTNAME="daos-camera"
BR2_TARGET_GENERIC_ISSUE="DaOS Linux / HassleFree FF-1 - synthetic development target"
# BR2_TARGET_ENABLE_ROOT_LOGIN is not set
# BR2_TARGET_GENERIC_GETTY is not set
# BR2_TARGET_GENERIC_REMOUNT_ROOTFS_RW is not set
BR2_ROOTFS_DEVICE_CREATION_DYNAMIC_MDEV=y
BR2_ROOTFS_USERS_TABLES="$(BR2_EXTERNAL_DAOS_CAMERA_PATH)/board/qemu-virt/users.txt"
BR2_ROOTFS_OVERLAY="$(BR2_EXTERNAL_DAOS_CAMERA_PATH)/board/qemu-virt/rootfs-overlay"
BR2_LINUX_KERNEL=y
BR2_LINUX_KERNEL_LATEST_VERSION=y
BR2_LINUX_KERNEL_USE_CUSTOM_CONFIG=y
BR2_LINUX_KERNEL_CUSTOM_CONFIG_FILE="$(BR2_EXTERNAL_DAOS_CAMERA_PATH)/board/qemu-virt/linux.config"
BR2_LINUX_KERNEL_NEEDS_HOST_OPENSSL=y
BR2_PACKAGE_PYTHON3=y
BR2_PACKAGE_PYTHON3_SQLITE=y
BR2_PACKAGE_PYTHON3_ZLIB=y
BR2_PACKAGE_PYTHON3_UNICODEDATA=y
BR2_PACKAGE_PYTHON3_SSL=y
BR2_PACKAGE_QT5=y
BR2_PACKAGE_QT5BASE=y
BR2_PACKAGE_QT5BASE_GUI=y
BR2_PACKAGE_QT5BASE_WIDGETS=y
BR2_PACKAGE_QT5BASE_OPENGL_ES2=y
BR2_PACKAGE_QT5BASE_OPENGL_LIB=y
BR2_PACKAGE_QT5BASE_LINUXFB=y
BR2_PACKAGE_QT5BASE_TEST=y
BR2_PACKAGE_QT5DECLARATIVE=y
BR2_PACKAGE_QT5DECLARATIVE_QUICK=y
BR2_PACKAGE_QT5QUICKCONTROLS2=y
BR2_PACKAGE_PYTHON_PYQT5=y
BR2_PACKAGE_MESA3D=y
BR2_PACKAGE_MESA3D_GALLIUM_DRIVER_SWRAST=y
BR2_PACKAGE_MESA3D_OPENGL_EGL=y
BR2_PACKAGE_MESA3D_OPENGL_ES=y
BR2_PACKAGE_DEJAVU=y
BR2_PACKAGE_HASSLEFREE_CAMERA=y
BR2_TARGET_ROOTFS_EXT2=y
BR2_TARGET_ROOTFS_EXT2_4=y
BR2_TARGET_ROOTFS_EXT2_SIZE="512M"
BR2_TARGET_ROOTFS_TAR=y
BR2_TARGET_ROOTFS_TAR_XZ=y
```

## system/buildroot/external/package/hasslefree/Config.in
```kconfig
config BR2_PACKAGE_HASSLEFREE_CAMERA
	bool "HassleFree native synthetic camera and DaOS-domain applications"
	depends on BR2_INSTALL_LIBSTDCPP
	depends on BR2_TOOLCHAIN_HAS_THREADS
	depends on BR2_USE_MMU
	depends on BR2_PACKAGE_QT5
	depends on BR2_PACKAGE_QT5DECLARATIVE_QUICK
	depends on BR2_PACKAGE_QT5BASE_OPENGL_LIB
	depends on BR2_PACKAGE_QT5QUICKCONTROLS2
	select BR2_PACKAGE_PYTHON3
	select BR2_PACKAGE_PYTHON3_SQLITE
	select BR2_PACKAGE_PYTHON3_ZLIB
	select BR2_PACKAGE_PYTHON3_UNICODEDATA
	select BR2_PACKAGE_PYTHON3_SSL
	select BR2_PACKAGE_PYTHON_PYQT5
	help
	  Cross-compile hf-camerad and its independent synthetic DNG worker
	  using this Buildroot target toolchain. Install the bounded Python
	  clients, saved-workflow runner, browser console and Qt/QML body UI.

	  This is a synthetic camera-domain implementation informed by DaOS
	  patterns, with no imported upstream DaOS framework source. It does
	  not provide a sensor driver, real RAW receiver, board BSP or measured
	  calibration. Project-wide redistribution grants remain unresolved;
	  third-party SQLite/nlohmann and system-package terms still apply.
```
